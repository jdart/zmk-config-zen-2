## config/west.yml
```yaml
manifest:
  remotes:
    - name: jdart
      url-base: https://github.com/jdart
  projects:
    - name: zmk
      remote: jdart
      revision: main
      import: app/west.yml
  self:
    path: config
```
